## bsp/ls2k0300/Kconfig
```kconfig
mainmenu "RT-Thread Configuration"

BSP_DIR := .

RTT_DIR := ../..

PKGS_DIR := packages

source "$(RTT_DIR)/Kconfig"
osource "$PKGS_DIR/Kconfig"
rsource "drivers/Kconfig"

config SOC_LA264
    bool
    select ARCH_LOONGARCH64
    select RT_USING_COMPONENTS_INIT
    select RT_USING_USER_MAIN
    default y
```

## bsp/ls2k0300/drivers/Kconfig
```kconfig
menu "Hardware Drivers Config"

    menuconfig BSP_USING_UART
        bool "Using UART"
        select RT_USING_SERIAL
        default y

        if BSP_USING_UART
            config BSP_USING_UART0
                bool "Using UART0"
                default y

            config BSP_USING_UART1
                bool "Using UART1"
                default n

            config BSP_USING_UART2
                bool "Using UART2"
                default n

            config BSP_USING_UART3
                bool "Using UART3"
                default n

            config BSP_USING_UART4
                bool "Using UART4"
                default n

            config BSP_USING_UART5
                bool "Using UART5"
                default y

            config BSP_USING_UART6
                bool "Using UART6"
                default n

            config BSP_USING_UART7
                bool "Using UART7"
                default n

            config BSP_USING_UART8
                bool "Using UART8"
                default n

            config BSP_USING_UART9
                bool "Using UART9"
                default n
        endif

endmenu
```

## bsp/qemu-virt64-loongarch32/Kconfig
```kconfig
mainmenu "RT-Thread Project Configuration"

BSP_DIR := .

RTT_DIR := ../..

PKGS_DIR := packages

source "$RTT_DIR/Kconfig"
source "$PKGS_DIR/Kconfig"

config SOC_LA132
    bool
    select ARCH_LOONGARCH32
    select RT_USING_COMPONENTS_INIT
    select RT_USING_USER_MAIN
    default y

source "$BSP_DIR/drivers/Kconfig"
```
